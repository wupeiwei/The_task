#include "oled.h"
#include "i2c.h"
#include <string.h>

/* SSD1306 I2C 地址：0x3C（7 位）→ HAL 里左移一位 0x78 */
#define OLED_ADDR  0x78
#define OLED_CMD   0x00   /* 控制字节：后续是命令 */
#define OLED_DATA  0x40   /* 控制字节：后续是数据 */

/* 写命令 */
static void oled_write_cmd(uint8_t cmd)
{
    HAL_I2C_Mem_Write(&hi2c1, OLED_ADDR, OLED_CMD, I2C_MEMADD_SIZE_8BIT, &cmd, 1, 50);
}

/* 写数据（连续写，比逐字节快很多） */
static void oled_write_data(const uint8_t *buf, uint16_t len)
{
    HAL_I2C_Mem_Write(&hi2c1, OLED_ADDR, OLED_DATA, I2C_MEMADD_SIZE_8BIT, (uint8_t *)buf, len, 50);
}

/* 定位：页地址 0~7（每页 8 像素行）+ 列地址 0~127 */
static void oled_set_pos(uint8_t page, uint8_t col)
{
    oled_write_cmd(0xB0 | (page & 0x07));                /* 页地址 */
    oled_write_cmd(0x00 | (col & 0x0F));                 /* 列低 4 位 */
    oled_write_cmd(0x10 | ((col >> 4) & 0x0F));          /* 列高 4 位 */
}

/* SSD1306 标准初始化序列（128x64，I2C） */
void oled_init(void)
{
    static const uint8_t init_seq[] = {
        0xAE,             /* display off */
        0xD5, 0x80,       /* 时钟分频 */
        0xA8, 0x3F,       /* 多路复用 1/64 */
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        0x2E,             /* 关闭滚动 */
        0xAF              /* display on */
    };
    for (uint16_t i = 0; i < sizeof(init_seq); i++)
        oled_write_cmd(init_seq[i]);
}

void oled_clear(void)
{
    uint8_t zeros[128] = {0};
    for (uint8_t page = 0; page < 8; page++)
    {
        oled_set_pos(page, 0);
        oled_write_data(zeros, 128);
    }
}

/* 6x8 字体：每个字符 5 列字节（高 8 位为一页），0x20~0x7F */
static const uint8_t font6x8[96][5] = {
    {0x00,0x00,0x00,0x00,0x00}, /* space */
    {0x00,0x00,0x5F,0x00,0x00}, /* ! */
    {0x00,0x07,0x00,0x07,0x00}, /* " */
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    {0x08,0x08,0x2A,0x1C,0x08}, /* ~ */
};

void oled_show_char(uint8_t page, uint8_t col, char ch)
{
    if (ch < 0x20 || ch > 0x7F) ch = ' ';   /* 只支持可打印 ASCII */
    oled_set_pos(page, col);
    oled_write_data(font6x8[ch - 0x20], 5);
}

void oled_show_string(uint8_t page, uint8_t col, const char *str)
{
    while (*str)
    {
        oled_show_char(page, col, *str++);
        col += 6;                 /* 5 列字符 + 1 列间距 */
        if (col > 127) break;     /* 防越界 */
    }
}

/* 右对齐定宽数字显示（len 为占位宽度，不足补空格） */
void oled_show_num(uint8_t page, uint8_t col, int32_t num, uint8_t len)
{
    char buf[12];
    uint8_t i = 11;
    buf[i--] = '\0';
    uint32_t n;
    if (num < 0)
    {
        buf[i--] = '-';                 /* 负号先占位 */
        n = (uint32_t)(-(int64_t)num);  /* int64 中间量防 INT32_MIN 取负溢出 */
    }
    else
        n = (uint32_t)num;
    do { buf[i--] = '0' + (n % 10); n /= 10; } while (n > 0);  /* 无符号转换，不依赖负数取余 */
    while (i > 0 && strlen(&buf[i + 1]) < len) buf[i--] = ' '; /* 不足 len 前补空格（右对齐） */
    oled_show_string(page, col, &buf[i + 1]);
}
